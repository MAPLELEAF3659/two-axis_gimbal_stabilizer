// Definitions for MPU6050
/dts-v1/;
/plugin/;

/ {
    compatible = "brcm,bcm2835";

    fragment@0 {
        target = <&i2c1>; // Target I2C bus 1 (usually enabled on Raspberry Pi)
        __overlay__ {
            #address-cells = <1>;
            #size-cells = <0>;

            mpu6050-ml@68 {
                compatible = "ml,mpu6050"; // Match the compatible string in your driver
                reg = <0x68>; // I2C address of the MPU6050
                status = "okay";
            };
        };
    };
};
